## vendor/oplus/kernel/network/linkpower_module/Kconfig
```kconfig
# SPDX-License-Identifier: GPL-2.0-only
# Copyright (C) 2018-2020 Oplus. All rights reserved.

config OPLUS_FEATURE_LINKPOWER_MODULE
        tristate "Add for linkpower modules"
        help
          Add for linkpower modules.
```
